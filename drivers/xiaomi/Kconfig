## drivers/xiaomi/Kconfig
```kconfig
menu "Xiaomi MIUI additions"

config XIAOMI_MIUI
	bool "Enable Xiaomi MIUI modifications"
	depends on BOARD_XIAOMI
	help
	  Enables compilation of Xiaomi MIUI specific vendor additions

	  Say Y if you want to compile the Xiaomi MIUI specific kernel modifications.
	  Say N if you want to discard the Xiaomi MIUI specific kernel modifications.

if XIAOMI_MIUI

config MIUI_ZRAM_MEMORY_TRACKING
	bool "Track zRam stats"
	depends on ZRAM
	help
	  With this feature, admin can track the state of zram
	  of zRAM. Admin could see the information via
	  /sys/block/zramX/.

	  See Documentation/blockdev/zram.txt for more information.

source "drivers/xiaomi/fragmention/Kconfig"

endif

endmenu
```
